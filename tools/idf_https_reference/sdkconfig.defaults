## tools/idf_https_reference/sdkconfig.defaults
```kconfig
CONFIG_ESP_WIFI_SSID="weforpay.com"
CONFIG_ESP_WIFI_PASSWORD="weforpay"
CONFIG_ESP_MAXIMUM_RETRY=5
CONFIG_LIBC_PICOLIBC_NEWLIB_COMPATIBILITY=n
CONFIG_ESP_CONSOLE_USB_SERIAL_JTAG=y
CONFIG_ESP_CONSOLE_UART_DEFAULT=n
```

## tools/idfboot/sdkconfig.defaults
```kconfig
CONFIG_IDF_TARGET="esp32s3"
CONFIG_BOOTLOADER_LOG_LEVEL=3
CONFIG_ESPTOOLPY_FLASHMODE="dio"
CONFIG_ESPTOOLPY_FLASHFREQ="40m"
CONFIG_ESPTOOLPY_FLASHSIZE_16MB=y
CONFIG_ESP_CONSOLE_USB_SERIAL_JTAG=y
CONFIG_PARTITION_TABLE_SINGLE_APP=y
CONFIG_ESPTOOLPY_FLASHSIZE="16MB"
CONFIG_SPIRAM=n
```
